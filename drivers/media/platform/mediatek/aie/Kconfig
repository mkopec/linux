## drivers/media/platform/mediatek/aie/Kconfig
```kconfig
config VIDEO_MTK_AIE
	tristate "Mediatek AI engine function"
	depends on OF
	select V4L2_MEM2MEM_DEV
	select VIDEOBUF2_DMA_CONTIG
	select MEDIA_CONTROLLER_REQUEST_API
	help
		Support the AI engine (AIE) feature

		AIE driver is a V4L2 memory-to-memory device driver which
		provides hardware accelerated face detection function,
		it can detect different sizes of faces in a raw image.
```
