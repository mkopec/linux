## Documentation/devicetree/bindings/input/touchscreen/himax,hx83102j.yaml
```yaml
# SPDX-License-Identifier: (GPL-2.0-only OR BSD-2-Clause)
%YAML 1.2
---
$id: http://devicetree.org/schemas/input/touchscreen/himax,hx83102j.yaml#
$schema: http://devicetree.org/meta-schemas/core.yaml#

title: Himax hx83102j touchscreen

maintainers:
  - Michał Kopeć <michal@nozomi.space>

description:
  The Himax HX83102J is a touch and display driver integrated (TDDI)
  controller. Its touch function is connected over SPI and reports HID
  packets. The display and touch functions share the analog supplies and
  the display reset, so the touch function is powered and reset together
  with the panel it is part of.

allOf:
  - $ref: /schemas/input/touchscreen/touchscreen.yaml#
  - $ref: /schemas/spi/spi-peripheral-props.yaml#

properties:
  compatible:
    const: himax,hx83102j

  reg:
    maxItems: 1

  interrupts:
    maxItems: 1

  reset-gpios:
    maxItems: 1

  vccd-supply:
    description: Digital I/O supply of the touch function.

  vsn-supply:
    description: Negative analog supply, shared with the display function.

  vsp-supply:
    description: Positive analog supply, shared with the display function.

  display-reset-gpios:
    maxItems: 1
    description:
      Reset of the display function, usually driven by the panel. Asserting
      it also resets the touch function.

  spi-cpha: true

  spi-cpol: true

  firmware-name:
    description: Specify the file name for firmware loading.

required:
  - compatible
  - reg
  - interrupts
  - reset-gpios
  - panel
  - vccd-supply
  - vsn-supply
  - vsp-supply
  - display-reset-gpios

unevaluatedProperties: false

examples:
  - |
    #include <dt-bindings/gpio/gpio.h>
    #include <dt-bindings/interrupt-controller/irq.h>
    spi {
      #address-cells = <1>;
      #size-cells = <0>;
      ap_ts: touchscreen@0 {
        compatible = "himax,hx83102j";
        reg = <0>;
        pinctrl-names = "default";
        pinctrl-0 = <&touch_int0 &touch_reset>;
        reset-gpios = <&gpio1 8 GPIO_ACTIVE_LOW>;
        spi-cpha;
        spi-cpol;
        interrupt-parent = <&gpio1>;
        interrupts = <7 IRQ_TYPE_LEVEL_LOW>;
        panel = <&panel>;
        vccd-supply = <&regulator>;
        vsn-supply = <&regulator>;
        vsp-supply = <&regulator>;
        display-reset-gpios = <&gpio1 9 GPIO_ACTIVE_LOW>;
      };
    };
```

## drivers/media/platform/mediatek/isp/Kconfig
```kconfig
# SPDX-License-Identifier: GPL-2.0-only
config VIDEO_MTK_ISP_71_CAMSYS
	tristate "MediaTek ISP 7.1 camsys driver"
	depends on ARCH_MEDIATEK || COMPILE_TEST
	depends on VIDEO_DEV
	depends on MTK_SCP
	select MEDIA_CONTROLLER
	select VIDEO_V4L2_SUBDEV_API
	select V4L2_FWNODE
	select VIDEOBUF2_DMA_CONTIG
	help
	  Support for the camera system of the MediaTek ISP 7.1, found in
	  the MT8188: the seninf CSI-2 receivers and the raw and YUV
	  processing pipelines. The ISP is driven through the camera
	  firmware running on the second SCP core.

	  To compile this driver as a module, choose M here: the modules
	  will be called mtk-cam-isp and mtk-cam-plat-util.
```
